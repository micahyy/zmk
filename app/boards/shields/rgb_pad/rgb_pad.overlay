/*
 * 12-key RGB pad for nRF52840 (e.g., Nice!Nano v2)
 * Matrix: 3 rows x 4 cols
 * RGB: WS2812, 12 LEDs, data on D6 (P0.08)
 */

#include <dt-bindings/gpio/nordic-gpio.h>
#include <dt-bindings/zmk/matrix-transform.h>

/ {
    chosen {
        zmk,kscan = &kscan0;
        zmk,underglow = &led_strip;   // Enable RGB underglow
    };

    /* WS2812 LED strip */
    led_strip: ws2812@0 {
        compatible = "worldsemi,ws2812-spi";
        label = "RGB LEDs";
        spi-dev = <&spi1>;            // SPI1 uses P0.08 (D6) as MOSI
        chain-length = <12>;          // ← Change this to your LED count
        spi-max-frequency = <2500000>;
        status = "okay";
    };

    /* GPIO Matrix Scan */
    kscan0: kscan_0 {
        compatible = "zmk,kscan-gpio-matrix";
        diode-direction = "col2row";

        // Columns: D2, D3, D4, D5 → P0.14, P0.15, P0.16, P0.17
        col-gpios
            = <&gpio0 14 GPIO_ACTIVE_HIGH>
            , <&gpio0 15 GPIO_ACTIVE_HIGH>
            , <&gpio0 16 GPIO_ACTIVE_HIGH>
            , <&gpio0 17 GPIO_ACTIVE_HIGH>;

        // Rows: D7, D8, D9 → P0.21, P0.08, P0.09
        row-gpios
            = <&gpio0 21 GPIO_ACTIVE_HIGH>
            , <&gpio0 8  GPIO_ACTIVE_HIGH>
            , <&gpio0 9  GPIO_ACTIVE_HIGH>;
    };
};