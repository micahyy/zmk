## app/boards/makerdiary/nrf52840_m2/Kconfig
```kconfig
# 版权声明：该文件版权归ZMK贡献者所有
# Copyright (c) 2020 The ZMK Contributors

# SPDX许可证标识符：该文件使用MIT许可证
# SPDX-License-Identifier: MIT

# 定义一个Kconfig配置选项，用于配置开发板的电源管理
# config: 开始定义一个新的配置选项
# BOARD_ENABLE_DCDC: 配置选项的名称（开发板使能DCDC模式）
config BOARD_ENABLE_DCDC
    # bool: 表示这是一个布尔类型（是/否）的配置选项
    # "Enable DCDC mode": 用户界面显示的描述文本
    bool "Enable DCDC mode"
    
    # select: 当这个选项被选中时，自动选择另一个依赖选项
    # SOC_DCDC_NRF52X: 自动选择nRF52x系列的DCDC外设驱动
    select SOC_DCDC_NRF52X
    
    # default y: 默认值为"是"（启用）
    # 这意味着如果不手动修改，该功能默认启用
    default y
    
    # depends on: 配置选项的依赖条件
    # BOARD_NRF52840_M2: 仅当目标开发板是nrf52840_m2时，此选项才可见/可用
    depends on BOARD_NRF52840_M2
```

## app/boards/makerdiary/nrf52840_m2/Kconfig.defconfig
```kconfig
# 版权声明：该文件版权归ZMK贡献者所有
# Copyright (c) 2020 The ZMK Contributors

# SPDX许可证标识符：该文件使用MIT许可证
# SPDX-License-Identifier: MIT

# 条件判断：如果目标开发板是NRF52840_M2
# 这个条件块中的配置仅适用于NRF52840_M2开发板
if BOARD_NRF52840_M2

# 嵌套条件判断：如果启用了USB设备栈
# USB_DEVICE_STACK 是Zephyr RTOS中USB设备功能的配置选项
if USB_DEVICE_STACK

# 配置USB驱动：使用nRF系列的USB驱动
# config: 开始定义配置选项
# USB_NRFX: nRF系列芯片的USB驱动程序配置
config USB_NRFX
    # default y: 默认启用该驱动
    # 当USB_DEVICE_STACK启用时，自动使用nRFX USB驱动
    default y

# 结束USB_DEVICE_STACK条件块
endif # USB_DEVICE_STACK

# 配置蓝牙控制器选项
# config: 开始定义蓝牙控制器的配置选项
# BT_CTLR: 蓝牙低功耗（BLE）控制器驱动
config BT_CTLR
    # default BT: 默认值与BT选项保持一致
    # 这意味着当BT（蓝牙功能）启用时，BT_CTLR也会自动启用
    # BT是顶层的蓝牙功能开关，BT_CTLR是实现蓝牙协议的底层控制器
    default BT

# 结束BOARD_NRF52840_M2条件块
endif # BOARD_NRF52840_M2
```

## app/boards/makerdiary/nrf52840_m2/Kconfig.nrf52840_m2
```kconfig
# 版权声明：该文件版权归ZMK贡献者所有
# Copyright (c) 2020 The ZMK Contributors

# SPDX许可证标识符：该文件使用Apache 2.0许可证
# SPDX-License-Identifier: Apache-2.0

# 定义开发板配置选项：NRF52840_M2开发板
# config: 开始定义一个新的Kconfig配置项
# BOARD_NRF52840_M2: 开发板标识符，表示这是针对NRF52840_M2开发板的配置
config BOARD_NRF52840_M2
    # select: 强制选择依赖项
    # SOC_NRF52840_QIAA: 选择nRF52840芯片的特定型号（QIAA封装）
    # 当BOARD_NRF52840_M2被选中时，SOC_NRF52840_QIAA也会自动被选中
    select SOC_NRF52840_QIAA
    
    # imply: 暗示/推荐选择某个选项（用户仍可以取消选择）
    # RETAINED_MEM: 保留内存功能，用于在系统复位或低功耗模式下保持数据
    # 当BOARD_NRF52840_M2被选中时，RETAINED_MEM会默认启用，但用户可以手动关闭
    imply RETAINED_MEM
    
    # imply: 暗示/推荐选择某个选项
    # RETENTION: 一般性的数据保持功能配置
    # 可能指芯片的保持寄存器或其他保持功能
    imply RETENTION
    
    # imply: 暗示/推荐选择某个选项
    # RETENTION_BOOT_MODE: 保持引导模式功能
    # 可能用于在复位后保持引导模式设置，或支持特殊启动流程
    imply RETENTION_BOOT_MODE
```

## app/boards/makerdiary/nrf52840_m2/board.yml
```yaml
# 开始定义开发板（board）配置的顶层键
board:
  # name: 开发板标识名称
  # 这里定义开发板名为 "nrf52840_m2"
  name: nrf52840_m2
  
  # vendor: 开发板制造商/供应商
  # 这里指定制造商为 "makerdiary"（日记创客）
  vendor: makerdiary
  
  # socs: 系统芯片（System on Chip）列表
  # 定义该开发板上使用的片上系统
  socs:
    # - name: 单个SoC的名称定义
    # 这里指定使用的SoC型号为 "nrf52840"
    # nrf52840是Nordic Semiconductor的一款蓝牙低功耗微控制器
    - name: nrf52840
```

## app/boards/makerdiary/nrf52840_m2/nrf52840_m2_defconfig
```kconfig
# 版权声明：该文件版权归ZMK贡献者所有
# Copyright (c) 2020 The ZMK Contributors

# SPDX许可证标识符：该文件使用MIT许可证
# SPDX-License-Identifier: MIT

# 启用ARM内存保护单元（MPU）
# 用于内存访问权限控制，增强系统安全性
CONFIG_ARM_MPU=y

# 启用GPIO（通用输入输出）驱动
# 提供对芯片引脚的控制功能
CONFIG_GPIO=y

# 启用使用设备树（Device Tree）定义的代码分区
# 允许根据设备树配置来划分存储空间
CONFIG_USE_DT_CODE_PARTITION=y

# 构建输出为UF2格式文件
# UF2是USB Flashing Format，专为USB大容量存储设备编程设计
# 常用于RP2040、nRF等芯片的拖放式编程
CONFIG_BUILD_OUTPUT_UF2=y

# 允许MPU下的闪存写入操作
# 通常MPU会限制对某些内存区域的写入，此配置允许写入闪存区域
CONFIG_MPU_ALLOW_FLASH_WRITE=y

# 启用NVS（非易失性存储）子系统
# 用于在闪存中存储键值对数据
CONFIG_NVS=y

# 启用基于NVS的设置存储系统
# 用于存储应用程序配置和设置
CONFIG_SETTINGS_NVS=y

# 启用闪存驱动
# 提供对闪存设备的访问接口
CONFIG_FLASH=y

# 启用闪存页面布局支持
# 允许查询闪存的页面大小和布局信息
CONFIG_FLASH_PAGE_LAYOUT=y

# 启用闪存映射支持
# 用于管理闪存区域的分区和映射
CONFIG_FLASH_MAP=y

# 启用ZMK的USB功能
# ZMK（Zephyr Mechanical Keyboard）框架的USB支持
# 可能用于键盘HID设备功能
CONFIG_ZMK_USB=y

# 启用ZMK的蓝牙低功耗（BLE）功能
# 提供蓝牙无线键盘功能
CONFIG_ZMK_BLE=y
```

## app/boards/shields/dm17/Kconfig.defconfig
```kconfig
# Copyright (c) 2020 The ZMK Contributors
# SPDX-License-Identifier: MIT

if SHIELD_czm17

config ZMK_KEYBOARD_NAME
default "czm17"

endif
```

## app/boards/shields/dm17/Kconfig.shield
```kconfig
# Copyright (c) 2020 The ZMK Contributors
# SPDX-License-Identifier: MITd

config SHIELD_czm17
def_bool $(shields_list_contains,czm17)
```

## app/boards/shields/m60/Kconfig.defconfig
```kconfig
# 版权声明：该文件版权归ZMK贡献者所有
# Copyright (c) 2020 The ZMK Contributors

# SPDX许可证标识符：该文件使用MIT许可证
# SPDX-License-Identifier: MIT

# 条件判断：如果使用M60键盘外壳（shield）
# SHIELD_M60 是Zephyr/ZMK中用于标识键盘外壳的配置选项
if SHIELD_M60

# 配置ZMK键盘名称
# config: 开始定义一个新的Kconfig配置项
# ZMK_KEYBOARD_NAME: ZMK框架中用于标识键盘名称的变量
config ZMK_KEYBOARD_NAME
    # default: 设置默认值
    # "m60": 将键盘名称默认设置为"m60"
    # 当SHIELD_M60被选中时，键盘名称自动设为"m60"
    default "m60"

# 结束条件判断块
endif
```

## app/boards/shields/m60/Kconfig.shield
```kconfig
# 版权声明：该文件版权归ZMK贡献者所有
# Copyright (c) 2020 The ZMK Contributors

# SPDX许可证标识符：该文件使用MIT许可证
# SPDX-License-Identifier: MIT

# 定义M60键盘外壳（shield）的配置选项
# config: 开始定义一个新的Kconfig配置项
# SHIELD_M60: 标识是否使用M60键盘外壳的配置变量
config SHIELD_M60
    # def_bool: 定义布尔类型变量的默认值
    # 使用条件表达式来确定默认值
    # $(shields_list_contains,m60): Kconfig函数调用
    #   检查shield列表中是否包含"m60"
    #   如果包含，则SHIELD_M60默认为y（是）
    #   如果不包含，则SHIELD_M60默认为n（否）
    def_bool $(shields_list_contains,m60)
```

## app/boards/shields/nd17/Kconfig.defconfig
```kconfig
# Copyright (c) 2020 The ZMK Contributors
# SPDX-License-Identifier: MIT

if SHIELD_nd17

config ZMK_KEYBOARD_NAME
    default "nd17"

endif
```

## app/boards/shields/nd17/Kconfig.shield
```kconfig
# Copyright (c) 2020 The ZMK Contributors
# SPDX-License-Identifier: MIT

config SHIELD_nd17
    def_bool $(shields_list_contains,nd17)
```
